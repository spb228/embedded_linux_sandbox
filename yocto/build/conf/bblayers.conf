## yocto/build/conf/bblayers.conf
```bitbake
# POKY_BBLAYERS_CONF_VERSION is increased each time build/conf/bblayers.conf
# changes incompatibly
POKY_BBLAYERS_CONF_VERSION = "2"

BBPATH = "${TOPDIR}"
BBFILES ?= ""

BBLAYERS ?= " \
  /home/spb/git/embedded_linux_sandbox/yocto/poky/meta \
  /home/spb/git/embedded_linux_sandbox/yocto/poky/meta-poky \
  /home/spb/git/embedded_linux_sandbox/yocto/poky/meta-yocto-bsp \
  "
```

## yocto/meta-board/conf/layer.conf
```bitbake
# We have a conf and classes directory, add to BBPATH
BBPATH .= ":${LAYERDIR}"

# We have recipes-* directories, add to BBFILES
BBFILES += "${LAYERDIR}/recipes-*/*/*.bb \
            ${LAYERDIR}/recipes-*/*/*.bbappend"

BBFILE_COLLECTIONS += "board"
BBFILE_PATTERN_board = "^${LAYERDIR}/"
BBFILE_PRIORITY_board = "6"

LAYERDEPENDS_board = "core"
LAYERSERIES_COMPAT_board = "scarthgap"

IMAGE_INSTALL:append = " helloworld"
```
